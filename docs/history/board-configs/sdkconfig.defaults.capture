## docs/history/board-configs/sdkconfig.defaults.capture
```kconfig
# S3 N16R8, no external DAC or display required.
CONFIG_AUDIO_CAPTURE_ENABLED=y
CONFIG_I2S_SCK_IO=-1
CONFIG_I2S_GND_IO=-1
CONFIG_I2S_VCC_IO=-1
CONFIG_OUTPUT_SAMPLE_RATE_44100=y
# CONFIG_BT_A2DP_ENABLE is not set

CONFIG_SPOTIFY_ENABLED=y
CONFIG_COMPILER_CXX_EXCEPTIONS=y
CONFIG_SPIRAM_ALLOW_STACK_EXTERNAL_MEMORY=y
CONFIG_MBEDTLS_CERTIFICATE_BUNDLE=y
CONFIG_LWIP_MAX_SOCKETS=24
```

## firmware/components/boards/Kconfig.projbuild
```kconfig
menu "Board Configuration"
    choice BOARD_TARGET
        prompt "Select Target Board"
        default BOARD_ESP32_GENERIC

        config BOARD_ESP32_GENERIC
            bool "LOVELACE AS-003 to AS-008 (ESP32-WROVER-E + PCM5102A)"
            depends on IDF_TARGET_ESP32
    endchoice

    config BOARD_TARGET_PATH
        string
        default "esp32-generic"

    menu "Pin Configuration"
        menu "LED GPIOs"
            config LED_STATUS_GPIO
                int "Status LED GPIO"
                default -1
                help
                    GPIO for status LED (single color). Set to -1 to disable.

            config LED_ERROR_GPIO
                int "Error LED GPIO"
                default -1
                help
                    GPIO for error LED. Set to -1 to disable.

            config LED_RGB_GPIO
                int "RGB LED GPIO (WS2812)"
                default -1
                help
                    GPIO for addressable RGB LED (WS2812). Set to -1 to disable.
        endmenu

        menu "I2S Pin Configuration"
            config I2S_SCK_IO
                int "I2S Master Clock GPIO"
                default -1
                help
                    I2S Master (system) Clock GPIO pin to use; needed with some I2S conversion boards.
                                        
            config I2S_BCK_IO
                int "I2S Bit Clock GPIO"
                default -1
                help
                    I2S Bit Clock GPIO pin to use.

            config I2S_WS_IO
                int "I2S Word Select GPIO"
                default -1
                help
                    I2S Word Select GPIO pin to use.

            config I2S_DO_IO
                int "I2S Data Output GPIO"
                default -1
                help
                    I2S Data Output GPIO pin to use.

            config I2S_GND_IO
                int "I2S GND GPIO"
                default -1
                help
                    GPIO to provide GND to I2S DAC if powered from GPIO.
                    20mA maximum! Set to -1 to disable.

            config I2S_VCC_IO
                int "I2S VCC GPIO"
                default -1
                help
                    GPIO to provide VCC to I2S DAC if powered from GPIO. 
                    20mA maximum! Set to -1 to disable.
        endmenu

        menu "Control GPIOs"
            config MUTE_GPIO
                int "Mute GPIO"
                default -1
                help
                    GPIO used to mute DAC/amplifier. Set to -1 to disable.

            config MUTE_GPIO_LEVEL
                int "Mute GPIO Active Level"
                default 0
                help
                    Active level for mute GPIO (0=active low, 1=active high).
        endmenu


    endmenu

endmenu
```
