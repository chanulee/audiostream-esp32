## firmware/main/Kconfig.projbuild
```kconfig
menu "Airplay ESP Configuration"
    config SPOTIFY_ENABLED
        bool "Spotify Connect receiver (cspot)"
        depends on SPIRAM && AUDIO_OUTPUT_I2S && OUTPUT_SAMPLE_RATE_44100
        select COMPILER_CXX_EXCEPTIONS
        default n

    config AUDIO_CAPTURE_ENABLED
        bool "Capture I2S PCM to PSRAM for WAV download"
        depends on SPIRAM
        default n

    menu "LED Configuration"
        config LED_STATUS_BRIGHTNESS
            int "Status LED brightness (0-100% duty for the on phase)"
            range 0 255
            default 60
            help
                Brightness level for the status LED (0=off, 255=max).

        config LED_STATUS_INVERT
            bool "Invert Status LED output (active-low)"
            default y
            help
                If enabled, the status LED output is inverted (active-low).
                Use this if your LED is connected with inverted logic
                (e.g., LED cathode to GPIO instead of anode).

        config LED_ERROR_INVERT
            bool "Invert Error LED output (active-low)"
            default y
            help
                If enabled, the error LED output is inverted (active-low).
                Use this if your LED is connected with inverted logic
                (e.g., LED cathode to GPIO instead of anode).

        menu "Status LED Behavior"
            choice LED_STATUS_ON_PLAYING
                prompt "Status LED when playing"
                default LED_STATUS_PLAYING_STEADY

                config LED_STATUS_PLAYING_STEADY
                    bool "Steady"
                config LED_STATUS_PLAYING_BLINK_FAST
                    bool "Blink fast"
                config LED_STATUS_PLAYING_VU
                    bool "VU meter"
            endchoice

            choice LED_STATUS_ON_PAUSED
                prompt "Status LED when paused"
                default LED_STATUS_PAUSED_BLINK_MEDIUM

                config LED_STATUS_PAUSED_OFF
                    bool "Off"
                config LED_STATUS_PAUSED_STEADY
                    bool "Steady"
                config LED_STATUS_PAUSED_BLINK_SLOW
                    bool "Blink slow"
                config LED_STATUS_PAUSED_BLINK_MEDIUM
                    bool "Blink medium"
            endchoice

            choice LED_STATUS_ON_STANDBY
                prompt "Status LED when standby"
                default LED_STATUS_STANDBY_BLINK_SLOW

                config LED_STATUS_STANDBY_OFF
                    bool "Off"
                config LED_STATUS_STANDBY_BLINK_SLOW
                    bool "Blink slow"
                config LED_STATUS_STANDBY_BLINK_MEDIUM
                    bool "Blink medium"
            endchoice
        endmenu

        menu "RGB LED Behavior"
            choice LED_RGB_ON_PLAYING
                prompt "RGB LED when playing"
                default LED_RGB_PLAYING_VU

                config LED_RGB_PLAYING_OFF
                    bool "Off"
                config LED_RGB_PLAYING_STEADY
                    bool "Steady color"
                config LED_RGB_PLAYING_VU
                    bool "VU meter"
            endchoice

            choice LED_RGB_ON_PAUSED
                prompt "RGB LED when paused"
                default LED_RGB_PAUSED_STEADY

                config LED_RGB_PAUSED_OFF
                    bool "Off"
                config LED_RGB_PAUSED_STEADY
                    bool "Steady color"
            endchoice

            choice LED_RGB_ON_STANDBY
                prompt "RGB LED when standby"
                default LED_RGB_STANDBY_OFF

                config LED_RGB_STANDBY_OFF
                    bool "Off"
                config LED_RGB_STANDBY_STEADY
                    bool "Steady color"
            endchoice

            config LED_RGB_COLOR_PAUSED
                hex "RGB color when paused (hex)"
                default 0x000033
                help
                    RGB color in hex (0xRRGGBB) for paused state.

            config LED_RGB_COLOR_STANDBY
                hex "RGB color when standby (hex)"
                default 0x001100
                help
                    RGB color in hex (0xRRGGBB) for standby state.
        endmenu
    endmenu

    menu "WiFi Configuration"
    config DEFAULT_AP_SSID
        string "Access Point SSID"
        default "ESP32-AirPlay-Setup"
        help
            SSID (network name) the ESP32 will broadcast.

    config DEFAULT_AP_PASSWORD
        string "Access Point Password"
        default ""
        help
            Password used for the Access Point. Leave empty and set AUTH MODE to WIFI_AUTH_OPEN for no password.

    config DEFAULT_AP_CHANNEL
        int "Access Point WiFi Channel"
        default 1
        help
            Be careful you might not see the access point if you use a channel not allowed in your country.

    config WIFI_PREFER_5GHZ
        bool "Prefer 5 GHz band when joining a network"
        default n
        help
            When a network with the configured SSID is available on both the
            2.4 GHz and 5 GHz bands (dual-band routers usually share one SSID),
            prefer connecting to the 5 GHz access point. Falls back to 2.4 GHz
            when no 5 GHz AP is found or the 5 GHz signal is too weak.

            Only chips with a dual-band radio (e.g. ESP32-C5) can use 5 GHz;
            on 2.4 GHz-only chips this option has no effect.

    config WIFI_PREFER_5GHZ_MIN_RSSI
        int "Minimum 5 GHz RSSI to prefer (dBm)"
        default -75
        range -95 -30
        depends on WIFI_PREFER_5GHZ
        help
            If the best 5 GHz AP is weaker than this RSSI (in dBm) and a
            2.4 GHz AP for the same SSID is available, fall back to 2.4 GHz
            for a more reliable link. Lower (more negative) values make the
            receiver stick to 5 GHz even at weak signal.
    endmenu

    menu "Audio Output"
    config AUDIO_OUTPUT_I2S
        bool
        default y

    choice OUTPUT_SAMPLE_RATE
        prompt "Output sample rate"
        default OUTPUT_SAMPLE_RATE_44100
        help
            Sample rate for I2S output. If the AirPlay source sends a
            different rate, the audio is resampled automatically.

        config OUTPUT_SAMPLE_RATE_44100
            bool "44100 Hz (native AirPlay, no resampling)"
        config OUTPUT_SAMPLE_RATE_48000
            bool "48000 Hz (resampled from 44100)"
    endchoice

    config OUTPUT_SAMPLE_RATE_HZ
        int
        default 48000 if OUTPUT_SAMPLE_RATE_48000
        default 44100

    config RESAMPLER_TAPS
        int "Resampler filter taps (quality)" if OUTPUT_SAMPLE_RATE_48000
        range 4 64
        default 28 if IDF_TARGET_ESP32S3
        default 12 if IDF_TARGET_ESP32
        default 16
        help
            Number of taps for the sinc resampler filters.
            More taps = better quality but higher CPU cost.
            Must be a multiple of 4.
            ESP32-S3 (hardware FPU): 28 recommended.
            ESP32 (no FPU): 12 recommended.

    endmenu

    menu "Bluetooth Configuration"
        depends on BT_A2DP_ENABLE

        config BT_PIN_CODE
            string "Bluetooth pairing PIN code"
            default "05032026"
            help
                Static PIN code used for legacy Bluetooth pairing.
                Must be 1-16 digits. Connecting devices will be
                prompted to enter this PIN.

        config BT_SSP_ENABLED
            bool "Enable Secure Simple Pairing (SSP)"
            default n
            help
                Enable SSP for Bluetooth 2.1+ devices. When enabled,
                headless devices use Just Works pairing (no display).
    endmenu

    menu "AirPlay Protocol"
        config AIRPLAY_FORCE_V1
            bool "Legacy mode: advertise AirPlay v1 (classic) only"
            default n
            help
                By default the receiver accepts BOTH AirPlay 1 (classic
                RAOP, used by TuneBlade, AirMusic, shairtunes2, older iOS
                fallback) and AirPlay 2 (HomeKit pairing, HAP-encrypted
                transport, used by current iOS). Protocol selection is
                automatic based on the request shape.

                Enable this option only if AirPlay 2 advertisement causes
                problems on your network (e.g. iOS preferring AirPlay 2
                with broken FairPlay verification). It hides the
                _airplay._tcp service entirely, leaving only _raop._tcp
                for classic RAOP clients. iOS will fall back to AirPlay 1
                with DACP remote control.

                When disabled (default), the receiver advertises as an
                AirPlay 2 device. Modern iOS uses the MRP (Media Remote
                Protocol) for remote control in AirPlay 2 mode, which
                is not implemented, so hardware play/pause falls back
                to local mute.

                Note: AirPlay v1 does not support RSA key exchange for
                audio encryption in this codebase. The receiver will
                advertise et=0 (no encryption). If iOS refuses to connect,
                audio encryption support may need to be added.

        config AIRPLAY_TIMING_THRESHOLD_MS
            int "Early/late timing threshold for buffered streams (ms)"
            default 25
            range 2 200
            help
                Maximum amount a frame may be early or late (in milliseconds)
                before the timing engine holds it as pending (early) or drops
                it (late). Buffered AirPlay 2 streams (AAC, type 103) have a
                deep jitter buffer, so a tight threshold keeps tight sync
                without causing drop-outs.

                This must stay comfortably above the I2S DMA ring's own
                jitter (about +/-3 ms with the default 8x256 descriptor
                config) plus PTP filter excursions, otherwise normal
                scheduling noise crosses the threshold and good audio is
                discarded. Steady-state accuracy is maintained by the
                one-sample drift servo rather than by a tight threshold, so
                lowering this does not improve sync — it only increases the
                chance of dropouts.

        config AIRPLAY_RT_TIMING_THRESHOLD_MS
            int "Early/late timing threshold for unbuffered streams (ms)"
            default 50
            range 2 500
            help
                Same as above but for unbuffered realtime streams (ALAC over
                UDP, type 96). Realtime streams have little or no jitter
                buffer to absorb scheduling hiccups (e.g. when image/metadata
                arrives on the RTSP connection), so a tight threshold causes
                audible drop-outs. A larger threshold tolerates the jitter at
                the cost of slightly looser sync. Increase this if you still
                hear drop-outs on AirPlay 1 / realtime playback.

        config ENABLE_AIRPLAY_ARTWORK
            bool "Enable cover-art / artwork reception"
            default n
            help
                Receive cover-art images. Enable it only if you have a display
                cabable of and want album art.
    endmenu

    menu "Button Configuration"
        config BTN_PLAY_PAUSE_GPIO
            int "Play/Pause button GPIO (-1 to disable)"
            default -1
            range -1 48
            help
                GPIO pin for the play/pause button (active-low, internal pull-up).
                Set to -1 to disable.

        config BTN_VOLUME_UP_GPIO
            int "Volume Up button GPIO (-1 to disable)"
            default -1
            range -1 48
            help
                GPIO pin for the volume up button (active-low, internal pull-up).
                Supports long-press auto-repeat.
                Set to -1 to disable.

        config BTN_VOLUME_DOWN_GPIO
            int "Volume Down button GPIO (-1 to disable)"
            default -1
            range -1 48
            help
                GPIO pin for the volume down button (active-low, internal pull-up).
                Supports long-press auto-repeat.
                Set to -1 to disable.

        config BTN_NEXT_GPIO
            int "Next Track button GPIO (-1 to disable)"
            default -1
            range -1 48
            help
                GPIO pin for the next track button (active-low, internal pull-up).
                Set to -1 to disable.

        config BTN_PREV_GPIO
            int "Previous Track button GPIO (-1 to disable)"
            default -1
            range -1 48
            help
                GPIO pin for the previous track button (active-low, internal pull-up).
                Set to -1 to disable.

        config BTN_SINGLE_BUTTON_UI
            bool "Single-button UI: double press = next, hold = Bluetooth pairing"
            default n
            help
                For boards with one button and no power switch. A double
                press skips to the next track; holding the button for 3 s
                drops the connected Bluetooth phone and makes the device
                discoverable so another phone can pair. Requires
                BTN_PLAY_PAUSE_DOUBLE_CLICK.

        config BTN_PLAY_PAUSE_DOUBLE_CLICK
            bool "Play/Pause double-click cycles channel mode"
            default n
            help
                When enabled, a single play/pause press is deferred until the
                double-click window expires. Two presses within that window
                cycle the audio channel mode instead of play/pause.
    endmenu
endmenu
```
